## arm/ttpms_is_2_0/Kconfig.board
```kconfig
# Copyright (c) 2023 Nordic Semiconductor ASA
# SPDX-License-Identifier: Apache-2.0

config BOARD_TTPMS_IS_2_0
	bool "TTPMS Internal Sensor V2"
	depends on SOC_NRF52833_QIAA
```

## arm/ttpms_is_2_0/Kconfig.defconfig
```kconfig
if BOARD_TTPMS_IS_2_0

config BOARD
	default "ttpms_is_2_0"

config BT_CTLR
   default BT

endif
```

## arm/ttpms_is_2_0/dts/bindings/mlx-power-switch.yaml
```yaml
description: GPIO pin to switch power to the MLX temperature sensor

compatible: "mlx-power-switch"

properties:
  gpios:
    type: phandle-array
    required: true
    description: |
      The GPIO connected to the gate of the MOSFET.
```

## arm/ttpms_rx_1_0/Kconfig.defconfig
```kconfig
# Copyright (c) 2023 Nordic Semiconductor ASA
# SPDX-License-Identifier: Apache-2.0

if BOARD_TTPMS_RX_1_0

config BOARD
	default "ttpms_rx_1_0"

config BT_CTLR
   default BT

endif
```

## arm/ttpms_rx_2_0/ttpms_rx_2_0_defconfig
```kconfig
# Copyright (c) 2023 Nordic Semiconductor ASA
# SPDX-License-Identifier: Apache-2.0

CONFIG_SOC_SERIES_NRF52X=y
CONFIG_SOC_NRF52833_QIAA=y
CONFIG_BOARD_TTPMS_RX_2_0=y

# Enable MPU
CONFIG_ARM_MPU=y

# Enable hardware stack protection
CONFIG_HW_STACK_PROTECTION=y

# Enable RTT
CONFIG_USE_SEGGER_RTT=y

# enable GPIO
CONFIG_GPIO=y

# additional board options
CONFIG_GPIO_AS_PINRESET=y

CONFIG_PINCTRL=y

# there's no 32.768KHz crystal on ttpms_rx_2_0
CONFIG_CLOCK_CONTROL_NRF_K32SRC_RC=y
CONFIG_CLOCK_CONTROL_NRF_K32SRC_XTAL=n
```
